// SPDX-License-Identifier: (GPL-2.0+ OR MIT)

/*
 * Deliberately separate from the normal display profile.  This imports the
 * proven display configuration and enables the exact charger policy recovered
 * from this tablet's Android DTB.
 */
#include "rk3326-863-tablet-display.dts"

/ {
	model = "Generic RK3326 863 tablet (1024x600 display, OEM charger test)";
};

&rk817 {
	charger {
		compatible = "rk817,charger";
		min_input_voltage = <4500>;
		max_input_current = <1500>;
		max_chrg_current = <2000>;
		max_chrg_voltage = <4400>;
		chrg_term_mode = <1>;
		chrg_finish_cur = <120>;
		virtual_power = <0>;
		dc_det_adc = <0>;
		status = "okay";
	};
};
